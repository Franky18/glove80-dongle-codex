/*
 * The stock Glove80 left board owns MoErgo's central-only Magic status LEDs.
 * This build uses the left board as a split peripheral, so remove only the
 * status-indicator node while keeping ordinary RGB underglow available.
 */

/ {
    chosen {
        /delete-property/ zmk,underglow-indicators;
    };

    /delete-node/ underglow-indicators;
};
