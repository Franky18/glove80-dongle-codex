/* Minimal keymap for the dongle settings-reset image. */

#include <behaviors.dtsi>

/ {
    keymap {
        compatible = "zmk,keymap";

        default_layer {
            bindings = <&sys_reset>;
        };
    };
};

