## config/boards/shields/glove80_dongle/Kconfig.defconfig
```kconfig
# Copyright (c) 2026
# SPDX-License-Identifier: MIT

if SHIELD_GLOVE80_DONGLE

config ZMK_KEYBOARD_NAME
    default "Glove80 Dongle"

config ZMK_SPLIT
    default y

config ZMK_SPLIT_ROLE_CENTRAL
    default y

config ZMK_SPLIT_BLE_CENTRAL_PERIPHERALS
    default 2

config BT_MAX_CONN
    default 7

config BT_MAX_PAIRED
    default 7

endif # SHIELD_GLOVE80_DONGLE

if SHIELD_GLOVE80_DONGLE_RESET

config ZMK_KEYBOARD_NAME
    default "G80 RESET"

endif # SHIELD_GLOVE80_DONGLE_RESET
```

## config/boards/shields/glove80_dongle/Kconfig.shield
```kconfig
# Copyright (c) 2026
# SPDX-License-Identifier: MIT

config SHIELD_GLOVE80_DONGLE
    def_bool $(shields_list_contains,glove80_dongle)

config SHIELD_GLOVE80_DONGLE_RESET
    def_bool $(shields_list_contains,glove80_dongle_reset)
```
